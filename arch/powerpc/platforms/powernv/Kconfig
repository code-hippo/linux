## arch/powerpc/platforms/powernv/Kconfig
```kconfig
config PPC_POWERNV
	depends on PPC64 && PPC_BOOK3S
	bool "IBM PowerNV (Non-Virtualized) platform support"
	select PPC_NATIVE
	select PPC_XICS
	select PPC_ICP_NATIVE
	select PPC_P7_NAP
	select PPC_PCI_CHOICE if EMBEDDED
	select EPAPR_BOOT
	select PPC_INDIRECT_PIO
	select PPC_UDBG_16550
	select PPC_SCOM
	select ARCH_RANDOM
	select CPU_FREQ
	select CPU_FREQ_GOV_PERFORMANCE
	select CPU_FREQ_GOV_POWERSAVE
	select CPU_FREQ_GOV_USERSPACE
	select CPU_FREQ_GOV_ONDEMAND
	select CPU_FREQ_GOV_CONSERVATIVE
	select PPC_DOORBELL
	default y

config OPAL_PRD
	tristate 'OPAL PRD driver'
	depends on PPC_POWERNV
	help
	  This enables the opal-prd driver, a facility to run processor
	  recovery diagnostics on OpenPower machines

config OPAL_OCC_SENSORS
	depends on PPC_POWERNV
	tristate "Perf support for OCC sensors"
	help
          This enables the perf driver for OCC-inabnd sensors, to read
	  the performance counters monitored by OCC (On-Chip-Controller)
	  Includes the perf interface for some of the system-level,
	  chip-level, core-level and power cap sensors
```
